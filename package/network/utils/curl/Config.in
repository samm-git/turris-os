## package/network/utils/curl/Config.in
```kconfig
if PACKAGE_libcurl

comment "SSL support"

choice
    	prompt "Selected SSL library"
	default LIBCURL_OPENSSL

	config LIBCURL_POLARSSL
		bool "PolarSSL"

	config LIBCURL_CYASSL
		bool "CyaSSL"

	config LIBCURL_AXTLS
		bool "axTLS"

	config LIBCURL_OPENSSL
		bool "OpenSSL"

	config LIBCURL_GNUTLS
		bool "GNUTLS"

	config LIBCURL_NOSSL
		bool "No SSL support"

endchoice

comment "Supported protocols"

config LIBCURL_DICT
	bool "DICT protocol"
	default n

config LIBCURL_FILE
	bool "FILE protocol"
	default y

config LIBCURL_FTP
	bool "FTP / FTPS protocol"
	default y

config LIBCURL_GOPHER
	bool "Gopher protocol"
	default n

config LIBCURL_HTTP
	bool "HTTP / HTTPS protocol"
	default y

config LIBCURL_COOKIES
	bool "Enable Cookies support"
	depends on LIBCURL_HTTP
	default y

config LIBCURL_IMAP
	bool "IMAP / IMAPS protocol"
	default n

config LIBCURL_LDAP
	bool "LDAP protocol"
	default n

config LIBCURL_LDAPS
	bool "Enable LDAPS support"
	depends on LIBCURL_LDAP && !LIBCURL_NOSSL
	default y

config LIBCURL_POP3
	bool "POP3 / POP3S protocol"
	default n

config LIBCURL_RTSP
	bool "RTSP protocol"
	depends on LIBCURL_HTTP
	default n
config LIBCURL_NO_RTSP
	string "RTSP require HTTP protocol"
	depends on !LIBCURL_HTTP
	default "!"

config LIBCURL_SSH2
	bool "SCP / SFTP protocol"
	default n

config LIBCURL_SMB
	bool "SMB protocol (CIFS)"
	depends on LIBCURL_CRYPTO_AUTH && (LIBCURL_GNUTLS || LIBCURL_OPENSSL)
	default n
config LIBCURL_NO_SMB
	string "SMB require 'cryptographic authentication' and either 'GnuTLS' or 'OpenSSL'"
	depends on !LIBCURL_CRYPTO_AUTH || (!LIBCURL_GNUTLS && !LIBCURL_OPENSSL)
	default "!"

config LIBCURL_SMTP
	bool "SMTP / SMTPS protocol"
	default n

config LIBCURL_TELNET
	bool "TELNET protocol"
	default n

config LIBCURL_TFTP
	bool "TFTP protocol"
	default n

comment "Miscellaneous"

config LIBCURL_PROXY
	bool "Enable proxy support"
	default y

config LIBCURL_CRYPTO_AUTH
	bool "Enable cryptographic authentication"
	default n

config LIBCURL_TLS_SRP
	bool "Enable TLS-SRP authentication"
	default n

config LIBCURL_LIBIDN
	bool "Enable IDN support"
	default n

config LIBCURL_THREADED_RESOLVER
	bool "Enable threaded DNS resolver"
	default n
	help
		Enable POSIX threaded asynchronous DNS resolution

config LIBCURL_ZLIB
	bool "Use zlib"
	default y
endif
```
